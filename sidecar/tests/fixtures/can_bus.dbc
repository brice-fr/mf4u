VERSION ""

NS_ :

BS_:

BU_:

BO_ 100 EngineStatus: 8 Vector__XXX
 SG_ EngineSpeed : 0|16@1+ (0.1,0) [0|6553.5] "rpm" Vector__XXX
 SG_ ThrottlePos : 16|8@1+ (0.4,-1) [0|100.0] "%" Vector__XXX

BO_ 200 VehicleStatus: 4 Vector__XXX
 SG_ VehicleSpeed : 0|16@1+ (0.05,0) [0|3276.75] "km/h" Vector__XXX
 SG_ Gear : 16|4@1+ (1,0) [0|8] "" Vector__XXX
